/dts-v1/;
/plugin/;

/ {
        fragment@0 {
		target-path = "/";
		__overlay__ {
			meba {
				board = "FPGA-LAN9698X-Sunrise";
				pcb = "0x6849";
				type = "0";
				target = "0x969C";
			};
		};
	};
};
