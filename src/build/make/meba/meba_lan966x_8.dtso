/dts-v1/;
/plugin/;

/ {
        fragment@0 {
		target-path = "/";
		__overlay__ {
			meba {
				board = "EVB-LAN9668-8port";
				type = "0";
				board_port_cnt = "8";
				target = "0x9668";
				pcb = "0x8290";
			};
		};
	};
        
        fragment@1 {
                target-path = "/soc/spi@e0804000/spi-flash@0";
                __overlay__ {
                        spi-max-frequency = <10000000>;
                };
        };
};
