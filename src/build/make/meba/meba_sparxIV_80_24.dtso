/dts-v1/;
/plugin/;

/ {
        fragment@0 {
		target-path = "/";
		__overlay__ {
			meba {
				board = "SparX-IV_80_24";
				type = "2";
				port_cfg = "2";
				target = "0x7448";
			};
		};
	};
};
