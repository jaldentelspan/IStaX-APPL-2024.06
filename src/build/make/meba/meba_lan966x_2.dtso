/dts-v1/;
/plugin/;

/ {
        fragment@0 {
		target-path = "/";
		__overlay__ {
			meba {
				board = "EVB-LAN9662";
				type = "0";
				board_port_cnt = "2";
				target = "0x9662";
				pcb = "0x8291";
			};
		};
	};
};
